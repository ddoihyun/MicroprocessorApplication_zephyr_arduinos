## CMakeLists.txt
```
cmake_minimum_required(VERSION 3.20.0)

# Include 디렉토리 설정
set(CMAKE_C_STANDARD 99)

find_package(Zephyr REQUIRED HINTS $ENV{ZEPHYR_BASE})
project(DHT_sensor)

# Include 디렉토리 추가
target_include_directories(app PRIVATE include)

# 소스 파일들 추가
target_sources(app PRIVATE 
    src/main.c
    src/dht_sensor.c
)
```

## prj.conf
```kconfig
CONFIG_GPIO=y
CONFIG_SENSOR=y
CONFIG_DHT=y

# RTT Console 설정
CONFIG_USE_SEGGER_RTT=y
CONFIG_RTT_CONSOLE=y
CONFIG_UART_CONSOLE=n

# 로깅 설정
CONFIG_LOG=y
CONFIG_LOG_DEFAULT_LEVEL=3
CONFIG_LOG_BACKEND_RTT=y
CONFIG_LOG_BACKEND_UART=n
```

## nrf52840dk_nrf52840.overlay
```dts
/ {
    aliases {
        dht0 = &dht22;
    };

    dht22: dht22 {
        compatible = "aosong,dht";
        status = "okay";
        dio-gpios = <&gpio0 11 (GPIO_PULL_UP | GPIO_ACTIVE_LOW)>;
        dht22;
    };
};
```

## src/main.c
```c
/*
 * Copyright (c) 2023 DHT22 Temperature and Humidity Sensor Application
 *
 * SPDX-License-Identifier: Apache-2.0
 */

#include <zephyr/kernel.h>
#include <zephyr/logging/log.h>
#include "dht_sensor.h"

LOG_MODULE_REGISTER(main, LOG_LEVEL_INF);

/* Sensor reading interval in milliseconds */
#define SENSOR_READ_INTERVAL_MS 2000

int main(void)
{
    int ret;
    struct dht_data sensor_data;
    
    LOG_INF("DHT22 Temperature and Humidity Sensor Application");
    LOG_INF("=================================================");
    
    /* Initialize DHT sensor */
    ret = dht_sensor_init();
    if (ret) {
        LOG_ERR("Failed to initialize DHT sensor: %d", ret);
        return ret;
    }
    
    LOG_INF("Starting sensor readings every %d ms", SENSOR_READ_INTERVAL_MS);
    LOG_INF("Sensor device: %s", dht_sensor_get_name());
    LOG_INF("=================================================");
    
    /* Main sensor reading loop */
    while (1) {
        /* Read sensor data */
        ret = dht_sensor_read(&sensor_data);
        if (ret) {
            LOG_ERR("Failed to read sensor data: %d", ret);
        } else {
            /* Print sensor data */
            dht_sensor_print_data(&sensor_data);
            LOG_INF("---");
        }
        
        /* Wait before next reading */
        k_msleep(SENSOR_READ_INTERVAL_MS);
    }
    
    return 0;
}
```

## include/dht_sensor.h
```c
/*
 * Copyright (c) 2023 DHT22 Temperature and Humidity Sensor
 *
 * SPDX-License-Identifier: Apache-2.0
 */

#ifndef DHT_SENSOR_H
#define DHT_SENSOR_H

#include <zephyr/kernel.h>
#include <zephyr/device.h>
#include <zephyr/drivers/sensor.h>
#include <zephyr/logging/log.h>

/**
 * @brief DHT sensor data structure
 */
struct dht_data {
    struct sensor_value temperature;
    struct sensor_value humidity;
    bool valid;
};

/**
 * @brief Initialize DHT sensor
 * 
 * @return 0 on success, negative error code on failure
 */
int dht_sensor_init(void);

/**
 * @brief Check if DHT sensor is ready
 * 
 * @return true if ready, false otherwise
 */
bool dht_sensor_is_ready(void);

/**
 * @brief Read temperature and humidity from DHT sensor
 * 
 * @param data Pointer to store sensor data
 * @return 0 on success, negative error code on failure
 */
int dht_sensor_read(struct dht_data *data);

/**
 * @brief Print sensor data to log
 * 
 * @param data Sensor data to print
 */
void dht_sensor_print_data(const struct dht_data *data);

/**
 * @brief Get device name
 * 
 * @return Device name string
 */
const char *dht_sensor_get_name(void);

#endif /* DHT_SENSOR_H */
```

## src/dht_sensor.c
```c
/*
 * Copyright (c) 2023 DHT22 Temperature and Humidity Sensor
 *
 * SPDX-License-Identifier: Apache-2.0
 */

#include "dht_sensor.h"

LOG_MODULE_REGISTER(dht_sensor, LOG_LEVEL_INF);

/* DHT device instance */
static const struct device *dht_dev;

int dht_sensor_init(void)
{
    dht_dev = DEVICE_DT_GET_ONE(aosong_dht);
    
    if (!dht_dev) {
        LOG_ERR("Failed to get DHT device");
        return -ENODEV;
    }
    
    if (!device_is_ready(dht_dev)) {
        LOG_ERR("Device %s is not ready", dht_dev->name);
        return -ENODEV;
    }
    
    LOG_INF("DHT22 sensor initialized successfully");
    LOG_INF("Device: %s", dht_dev->name);
    
    return 0;
}

bool dht_sensor_is_ready(void)
{
    return (dht_dev != NULL) && device_is_ready(dht_dev);
}

int dht_sensor_read(struct dht_data *data)
{
    int ret;
    
    if (!data) {
        return -EINVAL;
    }
    
    if (!dht_sensor_is_ready()) {
        LOG_ERR("DHT sensor not ready");
        return -ENODEV;
    }
    
    /* Initialize data structure */
    data->valid = false;
    
    /* Fetch sensor data */
    ret = sensor_sample_fetch(dht_dev);
    if (ret) {
        LOG_ERR("Sensor fetch failed: %d", ret);
        return ret;
    }
    
    /* Get temperature */
    ret = sensor_channel_get(dht_dev, SENSOR_CHAN_AMBIENT_TEMP, &data->temperature);
    if (ret) {
        LOG_ERR("Failed to get temperature: %d", ret);
        return ret;
    }
    
    /* Get humidity */
    ret = sensor_channel_get(dht_dev, SENSOR_CHAN_HUMIDITY, &data->humidity);
    if (ret) {
        LOG_ERR("Failed to get humidity: %d", ret);
        return ret;
    }
    
    data->valid = true;
    
    return 0;
}

void dht_sensor_print_data(const struct dht_data *data)
{
    if (!data || !data->valid) {
        LOG_WRN("Invalid sensor data");
        return;
    }
    
    LOG_INF("Temperature: %d.%06d °C", 
            data->temperature.val1, 
            data->temperature.val2);
    
    LOG_INF("Humidity: %d.%06d %%RH", 
            data->humidity.val1, 
            data->humidity.val2);
}

const char *dht_sensor_get_name(void)
{
    if (dht_dev) {
        return dht_dev->name;
    }
    return "Unknown";
}
```
